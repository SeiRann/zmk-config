## config/boards/shields/orchd/Kconfig.shield
```kconfig
# No whitespace after the comma or in your part name!
config SHIELD_ORCHD_LEFT
    def_bool $(shields_list_contains,orchd_left)

# No whitespace after the comma or in your part name!
config SHIELD_ORCHD_RIGHT
    def_bool $(shields_list_contains,orchd_right)
```
